## zephyr/dts/bindings/afe/owntech,afe-v3.yaml
```yaml
description: OwnTech AFE v3 analog front end

compatible: "owntech,afe-v3"

include: i2c-device.yaml

properties:
  reg:
    required: true
    description: TCA9555 7-bit address, normally 0x20 plus A2:A0.

  dac-address:
    type: int
    required: true
    description: MCP4728 7-bit address stored in the DAC EEPROM, normally 0x60.

  auto-provision:
    type: boolean
    description: |
      Provision the selected DAC after all Zephyr bus devices have initialized,
      then initialize this deferred AFE device. Requires zephyr,deferred-init,
      ldac-pulse-gpios, provision-scl-gpios and provision-sda-gpios.

  gpio-layout:
    type: string
    enum: ["v3-0", "v3-1"]
    default: "v3-0"
    description: TCA9555 pin assignment of the installed AFE revision.

  int-gpios:
    type: phandle-array
    description: Optional active-low TCA9555 INT connection.

  address-gpios:
    type: phandle-array
    description: |
      Optional GPIOs connected to TCA9555 A0, A1 and A2, in that order.
      All three entries must be provided. The driver drives the address encoded
      by reg before its first I2C transaction. Omit this property when the
      address pins are strapped on the board. When the TCA9555 is powered at
      5 V from a 3.3 V MCU, use suitable 5 V tolerant open-drain pins with
      external pull-ups or level translation.

  ldac-pulse-gpios:
    type: phandle-array
    description: |
      Optional shared MCU GPIO driving the gates of the LDAC selection MOSFETs.
      Active high: a high pulse pulls down the LDAC of the AFE selected by
      TCA9555 P0.6 on the v3.0 bodge, or P0.0 on v3.1.

  provision-scl-gpios:
    type: phandle-array
    description: Physical I2C SCL GPIO used for bit-timed DAC address writes.

  provision-sda-gpios:
    type: phandle-array
    description: Physical I2C SDA GPIO used for bit-timed DAC address writes.

  startup-gain:
    type: int
    default: 4
    description: Startup gain index. Index 4 is nominal gain x1.

  startup-bandwidth:
    type: int
    default: 7
    description: Startup bandwidth index.

  startup-dac-millivolts:
    type: array
    default: [2500, 2500, 2500, 3976]
    description: Startup values for SELF+, SELF-, input offset and output offset.
```

## zephyr/dts/bindings/sensor/mysentech,t117b.yaml
```yaml
description: Mysentech T117B I2C temperature sensor

compatible: "mysentech,t117b"

include: i2c-device.yaml
```

## zephyr/dts/bindings/sensor/owntech,hb-board.yaml
```yaml
description: OwnTech half-bridge board monitoring devices

compatible: "owntech,hb-board"

properties:
  high-side-sensor:
    type: phandle
    required: true
    description: T117B monitoring the high-side switch.

  low-side-sensor:
    type: phandle
    required: true
    description: T117B monitoring the low-side switch.

  eeprom:
    type: phandle
    required: true
    description: 24C02S EEPROM shared by the HB module.

  alert-gpios:
    type: phandle-array
    required: true
    description: High-side then low-side active-low T117B ALERT inputs.
```
