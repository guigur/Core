/*
 * Copyright (c) 2024 OwnTech.
 *
 * SPDX-License-Identifier: LGLPV2.1
 *
 * Ideally, this file's content should be contributed
 * to Zephyr's definition of STM32G4 SOC.
 */

 / {
	soc {
		can2 {
			compatible = "st,stm32-fdcan";
			status = "okay";
		};
	};
};
