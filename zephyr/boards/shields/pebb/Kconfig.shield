## zephyr/boards/shields/pebb/Kconfig.shield
```kconfig
# Copyright (c) 2026 OwnTech
# SPDX-License-Identifier: LGPL-2.1

config SHIELD_PEBB
	def_bool $(shields_list_contains,pebb)
```

## zephyr/dts/bindings/afe/owntech,afe-v3.yaml
```yaml
description: OwnTech AFE v3 analog front end

compatible: "owntech,afe-v3"

include: i2c-device.yaml

properties:
  reg:
    required: true
    description: TCA9555 7-bit address, normally 0x20 plus A2:A0.

  dac-address:
    type: int
    required: true
    description: MCP4728 7-bit address stored in the DAC EEPROM, normally 0x60.

  int-gpios:
    type: phandle-array
    description: Optional active-low TCA9555 INT connection.

  address-gpios:
    type: phandle-array
    description: |
      Optional GPIOs connected to TCA9555 A0, A1 and A2, in that order.
      All three entries must be provided. The driver drives the address encoded
      by reg before its first I2C transaction. Omit this property when the
      address pins are strapped on the board. When the TCA9555 is powered at
      5 V from a 3.3 V MCU, use suitable 5 V tolerant open-drain pins with
      external pull-ups or level translation.

  startup-gain:
    type: int
    default: 4
    description: Startup gain index. Index 4 is nominal gain x1.

  startup-bandwidth:
    type: int
    default: 7
    description: Startup bandwidth index.

  startup-dac-millivolts:
    type: array
    default: [2500, 2500, 2500, 3976]
    description: Startup values for SELF+, SELF-, input offset and output offset.
```

## zephyr/dts/bindings/i2c/owntech,tca9548a-nested.yaml
```yaml
description: OwnTech nested TCA9548A I2C switch

compatible: "owntech,tca9548a-nested"

include: [i2c-device.yaml]

properties:
  reset-gpios:
    type: phandle-array
    description: Optional active-low reset GPIO.

child-binding:
  description: Nested TCA9548A channel
  compatible: "owntech,tca9548a-nested-channel"
  include: [i2c-controller.yaml]
  on-bus: i2c
```

## zephyr/dts/bindings/misc/owntech,low-voltage-feeder.yaml
```yaml
description: OwnTech low-voltage feeder with persistent operating data

compatible: "owntech,low-voltage-feeder"

properties:
  eeprom:
    type: phandle
    required: true
    description: Native Zephyr EEPROM device fitted to the feeder.

  persist-interval-minutes:
    type: int
    default: 60
    description: Minimum accumulated operating time between EEPROM checkpoints.
```

## zephyr/dts/bindings/misc/owntech,pebb.yaml
```yaml
description: OwnTech PEBB board I2C topology
compatible: "owntech,pebb"

properties:
  root-i2c-mux:
    type: phandle
    required: true
  power-i2c-mux:
    type: phandle
    required: true
  alert-gpio-expander:
    type: phandle
    required: true
  control-gpio-expander:
    type: phandle
    required: true
  fan-fault-gpios:
    type: phandle-array
    required: true
    description: Three active-low fan fault inputs on U838, ordered FAN1 to FAN3.
  termination-gpios:
    type: phandle-array
    required: true
    description: U839 TERM120 output; enables CAN and RS485 terminations together.
  i2c-scl-select-gpios:
    type: phandle-array
    required: true
    description: U839 output selecting U726 SCL input (low PA15, high PA13).
  feeder:
    type: phandle
    required: true
  afe-main-bus:
    type: phandle
    required: true
  afe-sincos-bus:
    type: phandle
    required: true
  power-bus:
    type: phandle
    required: true
  feeder-bus:
    type: phandle
    required: true
  power-io-bus:
    type: phandle
    required: true
  hb1-bus:
    type: phandle
    required: true
  hb2-bus:
    type: phandle
    required: true
  hb3-bus:
    type: phandle
    required: true
```

## zephyr/dts/bindings/sensor/owntech,hb-board.yaml
```yaml
description: OwnTech half-bridge board monitoring devices

compatible: "owntech,hb-board"

properties:
  high-side-sensor:
    type: phandle
    required: true
    description: TMP117 monitoring the high-side switch.

  low-side-sensor:
    type: phandle
    required: true
    description: TMP117 monitoring the low-side switch.

  high-side-eeprom:
    type: phandle
    required: true
    description: EEPROM child of the high-side TMP117.

  low-side-eeprom:
    type: phandle
    required: true
    description: EEPROM child of the low-side TMP117.

  alert-gpios:
    type: phandle-array
    required: true
    description: High-side then low-side active-low TMP117 ALERT inputs.
```

## zephyr/modules/owntech_afe_driver/zephyr/Kconfig
```kconfig
config OWNTECH_AFE_DRIVER
	bool "OwnTech AFE v3 driver"
	default n
	select I2C
	select GPIO
	help
	  Enable support for the OwnTech AFE v3 board. Each AFE is described
	  as an I2C child in devicetree and can therefore be connected directly
	  to an I2C controller or through a TCA9548A channel.

if OWNTECH_AFE_DRIVER

config OWNTECH_AFE_DRIVER_INIT_PRIORITY
	int "AFE driver initialization priority"
	default 90
	help
	  Must be greater than the I2C controller and TCA9548A channel driver
	  initialization priorities.

module = OWNTECH_AFE_DRIVER
module-dep = LOG
module-str = OwnTech AFE driver
module-help = Sets the log level for the OwnTech AFE driver.
source "subsys/logging/Kconfig.template.log_config"

endif
```

## zephyr/modules/owntech_feeder_driver/zephyr/Kconfig
```kconfig
config OWNTECH_FEEDER_DRIVER
	bool "OwnTech low-voltage feeder driver"
	default y if DT_HAS_OWNTECH_LOW_VOLTAGE_FEEDER_ENABLED
	depends on DT_HAS_OWNTECH_LOW_VOLTAGE_FEEDER_ENABLED
	depends on EEPROM
	select CRC
	help
	  Expose the low-voltage feeder EEPROM and maintain its operating-time
	  counter in a CRC-protected, wear-levelled EEPROM journal.

if OWNTECH_FEEDER_DRIVER

config OWNTECH_FEEDER_DRIVER_INIT_PRIORITY
	int "Low-voltage feeder initialization priority"
	default 92
	help
	  Must be greater than the EEPROM initialization priority.

endif
```

## zephyr/modules/owntech_hb_driver/zephyr/Kconfig
```kconfig
config OWNTECH_HB_DRIVER
	bool "OwnTech half-bridge monitoring driver"
	default y if DT_HAS_OWNTECH_HB_BOARD_ENABLED
	depends on DT_HAS_OWNTECH_HB_BOARD_ENABLED
	depends on SENSOR && TMP116 && EEPROM && EEPROM_TMP116
	select GPIO
	help
	  Expose the two TMP117 temperature sensors, their integrated EEPROMs and
	  ALERT inputs as one device for each OwnTech half-bridge board.

if OWNTECH_HB_DRIVER

config OWNTECH_HB_DRIVER_INIT_PRIORITY
	int "Half-bridge monitoring initialization priority"
	default 92
	help
	  Must be greater than the sensor, EEPROM and GPIO expander priorities.

endif
```

## zephyr/modules/owntech_pebb_driver/zephyr/Kconfig
```kconfig
config OWNTECH_NESTED_TCA9548A
	bool "OwnTech nested TCA9548A support"
	default y if DT_HAS_OWNTECH_TCA9548A_NESTED_ENABLED
	depends on DT_HAS_OWNTECH_TCA9548A_NESTED_ENABLED
	select I2C
	help
	  Support U814 behind the U805 power-domain channel.

if OWNTECH_NESTED_TCA9548A
config OWNTECH_NESTED_TCA9548A_ROOT_INIT_PRIORITY
	int "Nested TCA9548A root initialization priority"
	default 52
config OWNTECH_NESTED_TCA9548A_CHANNEL_INIT_PRIORITY
	int "Nested TCA9548A channel initialization priority"
	default 53
endif

config OWNTECH_PEBB_DRIVER
	bool "PEBB board I2C topology driver"
	default y if SHIELD_PEBB
	depends on SHIELD_PEBB && OWNTECH_NESTED_TCA9548A
	help
	  Expose the PEBB I2C switches, their channels and the alert GPIO
	  expander as a board-level device. External plug-in cards remain optional.

if OWNTECH_PEBB_DRIVER
config OWNTECH_PEBB_DRIVER_INIT_PRIORITY
	int "PEBB board device initialization priority"
	default 85
	help
	  Must follow the I2C multiplexers and GPIO expander.

config OWNTECH_PEBB_FAN_POLL_MS
	int "PEBB fan fault polling period in milliseconds"
	range 10 10000
	default 250
	help
	  U838's interrupt pin is not wired to the MCU. Poll the three fan
	  tach watchdog outputs at this interval. The application should enable
	  critical monitoring only after a fan has had time to start.
endif

config OWNTECH_PEBB_AFE_CONTROL
	bool "PEBB ten-AFE group control"
	default y if SHIELD_PEBB
	depends on OWNTECH_PEBB_DRIVER && OWNTECH_AFE_DRIVER
	help
	  Expose the ten PEBB AFE devices by their functional names and
	  provide best-effort group operations.

config OWNTECH_PEBB_HB_CONTROL
	bool "PEBB three-HB group control"
	default y if SHIELD_PEBB
	depends on OWNTECH_PEBB_DRIVER && OWNTECH_HB_DRIVER
	help
	  Expose the three PEBB half-bridge devices by position.
```
